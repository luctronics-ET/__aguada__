## .old_firmware/.old_firmware_MIN/node_minimal/sdkconfig.defaults
```kconfig
# AGUADA Node Minimal - Configuração padrão
# Target: ESP32-C3

# Flash
CONFIG_ESPTOOLPY_FLASHSIZE_4MB=y
CONFIG_ESPTOOLPY_FLASHMODE_DIO=y

# Partição simples (sem OTA por enquanto)
CONFIG_PARTITION_TABLE_SINGLE_APP=y

# Log level
CONFIG_LOG_DEFAULT_LEVEL_INFO=y

# WiFi
CONFIG_ESP_WIFI_STATIC_RX_BUFFER_NUM=4
CONFIG_ESP_WIFI_DYNAMIC_RX_BUFFER_NUM=8
CONFIG_ESP_WIFI_TX_BUFFER_TYPE=0
CONFIG_ESP_WIFI_STATIC_TX_BUFFER_NUM=4

# ESP-NOW
CONFIG_ESP_WIFI_ESPNOW_MAX_ENCRYPT_NUM=0

# FreeRTOS
CONFIG_FREERTOS_HZ=1000

# Power management (desativado por simplicidade)
CONFIG_PM_ENABLE=n

# Watchdog
CONFIG_ESP_TASK_WDT_TIMEOUT_S=10
```

## .old_firmware/gateway_OTA_01/sdkconfig.defaults
```kconfig
# AGUADA Gateway OTA - Configuração padrão para ESP32 DevKit v1

# Partition table for OTA (two app partitions)
CONFIG_PARTITION_TABLE_TWO_OTA=y

# WiFi
CONFIG_WIFI_SSID="luciano"
CONFIG_WIFI_PASSWORD="Luciano19852012"

# Backend
CONFIG_BACKEND_HOST="192.168.0.117"
CONFIG_BACKEND_PORT=3000

# ESP-NOW
CONFIG_ESPNOW_CHANNEL=11

# Gateway mode (0=primary, 1=repeater)
CONFIG_GATEWAY_MODE=0
CONFIG_GATEWAY_MODE_PRIMARY=y

# Primary gateway MAC (for repeater mode)
CONFIG_PRIMARY_GATEWAY_MAC="80:f1:b2:50:2e:c4"

# Logging
CONFIG_LOG_DEFAULT_LEVEL_INFO=y
CONFIG_LOG_MAXIMUM_LEVEL_DEBUG=y

# HTTP Client
CONFIG_ESP_HTTP_CLIENT_ENABLE_HTTPS=y
CONFIG_ESP_HTTP_CLIENT_ENABLE_BASIC_AUTH=n

# OTA
CONFIG_BOOTLOADER_APP_ROLLBACK_ENABLE=y

# FreeRTOS
CONFIG_FREERTOS_HZ=1000

# Watchdog
CONFIG_ESP_TASK_WDT_TIMEOUT_S=30

# Flash size (4MB for DevKit v1)
CONFIG_ESPTOOLPY_FLASHSIZE_4MB=y
```

## .old_firmware/node_sensor_11/sdkconfig.defaults
```kconfig
# Configurações padrão para ESP32-C3
CONFIG_IDF_TARGET="esp32c3"
CONFIG_IDF_TARGET_ESP32C3=y

# Logs
CONFIG_LOG_DEFAULT_LEVEL_INFO=y
CONFIG_LOG_MAXIMUM_LEVEL_DEBUG=y

# WiFi
CONFIG_ESP_WIFI_MODE_STA=y

# ESP-NOW
CONFIG_ESPNOW_ENABLE=y

# Otimizações
CONFIG_COMPILER_OPTIMIZATION_SIZE=y
CONFIG_BOOTLOADER_LOG_LEVEL_WARN=y
```

## .snapshots/___DELETE___/.old_firmware/.old_firmware_MIN/gateway_usb/sdkconfig.defaults
```kconfig
# AGUADA Gateway USB - Configuração padrão
# Target: ESP32-C3 (ou ESP32)

# Flash
CONFIG_ESPTOOLPY_FLASHSIZE_4MB=y
CONFIG_ESPTOOLPY_FLASHMODE_DIO=y

# Partição simples
CONFIG_PARTITION_TABLE_SINGLE_APP=y

# Log level (INFO para debug, pode mudar para WARN em produção)
CONFIG_LOG_DEFAULT_LEVEL_INFO=y

# WiFi (para ESP-NOW)
CONFIG_ESP_WIFI_STATIC_RX_BUFFER_NUM=8
CONFIG_ESP_WIFI_DYNAMIC_RX_BUFFER_NUM=16
CONFIG_ESP_WIFI_TX_BUFFER_TYPE=0
CONFIG_ESP_WIFI_STATIC_TX_BUFFER_NUM=8

# ESP-NOW
CONFIG_ESP_WIFI_ESPNOW_MAX_ENCRYPT_NUM=0

# FreeRTOS
CONFIG_FREERTOS_HZ=1000

# Console/UART (importante para USB Serial)
CONFIG_ESP_CONSOLE_UART_DEFAULT=y
CONFIG_ESP_CONSOLE_UART_BAUDRATE=115200

# USB CDC (para ESP32-C3 com USB nativo)
CONFIG_ESP_CONSOLE_USB_SERIAL_JTAG=n
```

## .snapshots/___DELETE___/.old_firmware/gateway_OTA_01/main/Kconfig.projbuild
```kconfig
menu "AGUADA Gateway OTA Configuration"

    config WIFI_SSID
        string "WiFi SSID"
        default "luciano"
        help
            SSID da rede WiFi

    config WIFI_PASSWORD
        string "WiFi Password"
        default "password"
        help
            Senha da rede WiFi

    config BACKEND_HOST
        string "Backend Host"
        default "192.168.0.117"
        help
            IP ou hostname do servidor backend

    config BACKEND_PORT
        int "Backend Port"
        default 3000
        help
            Porta do servidor backend

    config ESPNOW_CHANNEL
        int "ESP-NOW Channel"
        range 1 14
        default 11
        help
            Canal WiFi para ESP-NOW (deve coincidir com o SSID)

    choice GATEWAY_MODE
        prompt "Gateway Mode"
        default GATEWAY_MODE_PRIMARY
        help
            Modo de operação do gateway

        config GATEWAY_MODE_PRIMARY
            bool "Primary (HTTP POST direto)"
            help
                Gateway primário - envia dados diretamente para o backend via HTTP

        config GATEWAY_MODE_REPEATER
            bool "Repeater (retransmite para outro gateway)"
            help
                Gateway repetidor - retransmite pacotes ESP-NOW para o gateway primário
    endchoice

    config GATEWAY_MODE
        int
        default 0 if GATEWAY_MODE_PRIMARY
        default 1 if GATEWAY_MODE_REPEATER

    config PRIMARY_GATEWAY_MAC
        string "Primary Gateway MAC (para modo repeater)"
        default "80:f1:b2:50:2e:c4"
        depends on GATEWAY_MODE_REPEATER
        help
            MAC do gateway primário (formato XX:XX:XX:XX:XX:XX)

endmenu
```

## firmware/gateway_00/sdkconfig.defaults
```kconfig
# ESP32-C3 Configuration for AGUADA Gateway
CONFIG_IDF_TARGET="esp32c3"

# WiFi Configuration
CONFIG_ESP32_WIFI_STATIC_RX_BUFFER_NUM=16
CONFIG_ESP32_WIFI_DYNAMIC_RX_BUFFER_NUM=32
CONFIG_ESP32_WIFI_TX_BUFFER_TYPE=1
CONFIG_ESP32_WIFI_DYNAMIC_TX_BUFFER_NUM=32
CONFIG_ESP32_WIFI_AMPDU_TX_ENABLED=y
CONFIG_ESP32_WIFI_AMPDU_RX_ENABLED=y
CONFIG_ESP32_WIFI_NVS_ENABLED=y

# FreeRTOS
CONFIG_FREERTOS_HZ=1000
CONFIG_FREERTOS_WATCHPOINT_END_OF_STACK=y

# Watchdog
CONFIG_ESP_TASK_WDT=y
CONFIG_ESP_TASK_WDT_TIMEOUT_S=60
CONFIG_ESP_TASK_WDT_PANIC=y

# Serial Monitor
CONFIG_ESP_CONSOLE_UART_DEFAULT=y
CONFIG_ESP_CONSOLE_UART_NUM=0
CONFIG_ESP_CONSOLE_UART_BAUDRATE=115200

# Arduino Configuration
CONFIG_ENABLE_ARDUINO_DEPENDS=y
CONFIG_AUTOSTART_ARDUINO=y

# Flash size
CONFIG_ESPTOOLPY_FLASHSIZE_4MB=y

# Partition Table
CONFIG_PARTITION_TABLE_SINGLE_APP=y

# LWIP (TCP/IP Stack)
CONFIG_LWIP_MAX_SOCKETS=16
CONFIG_LWIP_SO_REUSE=y
CONFIG_LWIP_SO_RCVBUF=y

# TCP/IP Adapter
CONFIG_LWIP_TCP_MSS=1460
CONFIG_LWIP_TCP_SND_BUF_DEFAULT=5760
CONFIG_LWIP_TCP_RCV_WND_DEFAULT=5760
```

## firmware/gateway_usb/sdkconfig.defaults
```kconfig
# Configurações padrão para ESP32-C3 SuperMini
# Gateway USB - Bridge ESP-NOW para Serial

# Configuração do target
CONFIG_IDF_TARGET="esp32c3"

# Console USB nativo (importante para C3 SuperMini!)
CONFIG_ESP_CONSOLE_USB_SERIAL_JTAG=y

# Logs
CONFIG_LOG_DEFAULT_LEVEL_INFO=y
CONFIG_LOG_MAXIMUM_LEVEL_DEBUG=y

# FreeRTOS
CONFIG_FREERTOS_HZ=1000

# WiFi/ESP-NOW
CONFIG_ESP_WIFI_STATIC_RX_BUFFER_NUM=10
CONFIG_ESP_WIFI_DYNAMIC_RX_BUFFER_NUM=32
CONFIG_ESP_WIFI_AMPDU_TX_ENABLED=n
CONFIG_ESP_WIFI_AMPDU_RX_ENABLED=n

# Otimização de tamanho
CONFIG_COMPILER_OPTIMIZATION_SIZE=y

# Watchdog
CONFIG_ESP_TASK_WDT_TIMEOUT_S=10
```

## firmware/node_sensor_20/sdkconfig.defaults
```kconfig
# ESP32-C3 Configuration
CONFIG_IDF_TARGET="esp32c3"

# Compiler options
CONFIG_COMPILER_OPTIMIZATION_SIZE=y

# ESP System Settings
CONFIG_ESP_SYSTEM_EVENT_TASK_STACK_SIZE=4096
CONFIG_ESP_MAIN_TASK_STACK_SIZE=8192

# FreeRTOS
CONFIG_FREERTOS_HZ=1000
CONFIG_FREERTOS_UNICORE=y

# ESP-NOW
CONFIG_ESP_WIFI_ESPNOW_MAX_ENCRYPT_NUM=0

# Log Level
CONFIG_LOG_DEFAULT_LEVEL_INFO=y
CONFIG_LOG_MAXIMUM_LEVEL_VERBOSE=y

# WiFi
CONFIG_ESP32_WIFI_STATIC_RX_BUFFER_NUM=16
CONFIG_ESP32_WIFI_DYNAMIC_RX_BUFFER_NUM=32
CONFIG_ESP32_WIFI_DYNAMIC_TX_BUFFER_NUM=32
CONFIG_ESP_WIFI_AMPDU_TX_ENABLED=n
CONFIG_ESP_WIFI_AMPDU_RX_ENABLED=n

# LWIP
CONFIG_LWIP_MAX_SOCKETS=4

# Partition Table
CONFIG_PARTITION_TABLE_SINGLE_APP_LARGE=y
```
